## image/phase1.its
```
/dts-v1/;

/ {
	description = "Onyx KVM Phase 1 boot image";
	#address-cells = <2>;

	images {
		kernel-1 {
			description = "Onyx KVM Linux kernel";
			data = /incbin/("Image");
			type = "kernel";
			arch = "riscv";
			os = "linux";
			compression = "none";
			load = <0x0 0x80200000>;
			entry = <0x0 0x80200000>;
			hash-1 { algo = "sha256"; };
		};

		fdt-sg2002_licheervnano_sd {
			description = "SG2002 LicheeRV Nano device tree";
			data = /incbin/("sg2002_licheervnano_sd.dtb");
			type = "flat_dt";
			arch = "riscv";
			compression = "none";
			hash-1 { algo = "sha256"; };
		};
	};

	configurations {
		default = "config-sg2002_licheervnano_sd";

		config-sg2002_licheervnano_sd {
			description = "Onyx KVM SG2002 recovery system";
			kernel = "kernel-1";
			fdt = "fdt-sg2002_licheervnano_sd";
		};
	};
};
```
